## meta-mjmech/conf/layer.conf
```bitbake
# We have a conf and classes directory, add to BBPATH
BBPATH .= ":${LAYERDIR}"

# We have recipes-* directories, add to BBFILES
BBFILES += "${LAYERDIR}/recipes-*/*/*.bb \
            ${LAYERDIR}/recipes-*/*/*.bbappend"

BBFILE_COLLECTIONS += "mjmech"
BBFILE_PATTERN_mjmech = "^${LAYERDIR}/"
BBFILE_PRIORITY_mjmech = "5"
LAYERVERSION_mjmech = "1"

META_MJMECH_BASE := '${LAYERDIR}'

LICENSE_FLAGS_WHITELIST += "commercial"

# TODO(jpieper): I don't know the syntax for putting this in the
# .bbappend file, so sticking it here for now.
SECURITY_CFLAGS_pn-log4cpp = "${SECURITY_NO_PIE_CFLAGS}"

SUPPORTED_RECIPES_append = " ${META_MJMECH_BASE}/conf/include/supported-recipes.txt"
```
